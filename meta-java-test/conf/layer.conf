## meta-java-test/conf/layer.conf
```bitbake
# We have a conf and classes directory, add to BBPATH
BBPATH .= ":${LAYERDIR}"

LAYERDEPENDS_meta-java-test = "core"
LAYERSERIES_COMPAT_meta-java-test = "walnascar"
```
